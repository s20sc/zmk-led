## config/boards/shields/dilemma/Kconfig.defconfig
```kconfig
if SHIELD_DILEMMA_LEFT

    config ZMK_KEYBOARD_NAME
        default "Dilemma"

    config ZMK_SPLIT_BLE_ROLE_CENTRAL
        default y

endif # LEFT



if SHIELD_DILEMMA_LEFT || SHIELD_DILEMMA_RIGHT

    config ZMK_SPLIT
        default y

endif # LEFT RIGHT



if ZMK_DISPLAY

config SPI
	default y

config LS0XX
	default y

config ZMK_WIDGET_WPM_STATUS
	default y if !ZMK_SPLIT || ZMK_SPLIT_ROLE_CENTRAL

config LVGL_BITS_PER_PIXEL
	default 1

choice LVGL_COLOR_DEPTH
	default LVGL_COLOR_DEPTH_1
endchoice

endif # ZMK_DISPLAY

endif
```
